/dts-v1/;

/ {
	compatible = "qcom,qcs605-mtp", "qcom,qcs605", "qcom,mtp";
	model = "Qualcomm Technologies, Inc. QC605 LC Groot + PM8005 IPC";
	qcom,board-id = <0x20208 0x4>;
	qcom,msm-id = <0x15b 0x0>;

	__fixups__ {
		cam_cci = "/fragment@5:target:0";
		cam_sensor_ir_led_off = "/fragment@4/__overlay__/qcom,camera-ir-led@0:pinctrl-1:0";
		cam_sensor_ir_led_on = "/fragment@4/__overlay__/qcom,camera-ir-led@0:pinctrl-0:0";
		cam_sensor_mclk0_active = "/fragment@5/__overlay__/qcom,cam-sensor@0:pinctrl-0:0";
		cam_sensor_mclk0_suspend = "/fragment@5/__overlay__/qcom,cam-sensor@0:pinctrl-1:0";
		cam_sensor_rear_active = "/fragment@5/__overlay__/qcom,cam-sensor@0:pinctrl-0:4";
		cam_sensor_rear_suspend = "/fragment@5/__overlay__/qcom,cam-sensor@0:pinctrl-1:4";
		cdc_reset_active = "/fragment@24/__overlay__/msm_cdc_pinctrl@11:pinctrl-0:0";
		cdc_reset_sleep = "/fragment@24/__overlay__/msm_cdc_pinctrl@11:pinctrl-1:0";
		clock_camcc = "/fragment@5/__overlay__/qcom,cam-sensor@0:clocks:0";
		clock_rpmh = "/fragment@11/__overlay__/audio_ext_clk_lnbb:clocks:0";
		dai_slim = "/fragment@22:target:0";
		eud = "/fragment@3/__overlay__:extcon:8";
		ext_disp_audio_codec = "/fragment@9/__overlay__:asoc-codec:4";
		glink_spi_xprt_wdsp = "/fragment@11/__overlay__/qcom,wcd-dsp-mgr:qcom,wdsp-components:16";
		int_codec = "/fragment@25:target:0";
		jack_det_linein_default = "/fragment@23/__overlay__:pinctrl-0:0";
		jack_det_lineout_default = "/fragment@23/__overlay__:pinctrl-0:4";
		pm660_0 = "/fragment@0:target:0";
		pm660_1 = "/fragment@1:target:0";
		pm660_div_clk = "/fragment@11/__overlay__/audio_ext_clk:clocks:0";
		pm660_gpios = "/fragment@11/__overlay__/audio_ext_clk:qcom,audio-ref-clk-gpio:0";
		pm660_l11 = "/fragment@5/__overlay__/qcom,cam-sensor@0:cam_vio-supply:0";
		pm660_l15 = "/fragment@5/__overlay__/qcom,cam-sensor@0:cam_vana-supply:0";
		pm660_l17 = "/fragment@2/__overlay__:vdd-pdphy-supply:0";
		pm660_l18 = "/fragment@17/__overlay__:vdd-io-supply:0";
		pm660_l19 = "/fragment@15/__overlay__:vdd-supply:0";
		pm660_l5 = "/fragment@5/__overlay__/qcom,cam-sensor@0:cam_vdig-supply:0";
		pm660_l8 = "/fragment@15/__overlay__:vdd-io-supply:0";
		pm660_misc = "/fragment@1/__overlay__/qcom,haptics@c000:qcom,pmic-misc:0";
		pm660_pdphy = "/fragment@2:target:0", "/fragment@3/__overlay__:extcon:0", "/fragment@3/__overlay__:extcon:4";
		pm660_revid = "/fragment@0/__overlay__/qcom,qpnp-smb2:qcom,pmic-revid:0", "/fragment@0/__overlay__/rradc@4500:qcom,pmic-revid:0", "/fragment@0/__overlay__/qpnp,fg:qcom,pmic-revid:0", "/fragment@1/__overlay__/qcom,haptics@c000:qcom,pmic-revid:0";
		qupv3_se12_2uart = "/fragment@14:target:0";
		qupv3_se8_spi = "/fragment@20:target:0";
		qupv3_se9_2uart = "/fragment@13:target:0";
		qusb_phy0 = "/fragment@0/__overlay__/qcom,qpnp-smb2:dpdm-supply:0";
		sdc1_clk_off = "/fragment@15/__overlay__:pinctrl-1:0";
		sdc1_clk_on = "/fragment@15/__overlay__:pinctrl-0:0";
		sdc1_cmd_off = "/fragment@15/__overlay__:pinctrl-1:4";
		sdc1_cmd_on = "/fragment@15/__overlay__:pinctrl-0:4";
		sdc1_data_off = "/fragment@15/__overlay__:pinctrl-1:8";
		sdc1_data_on = "/fragment@15/__overlay__:pinctrl-0:8";
		sdc1_rclk_off = "/fragment@15/__overlay__:pinctrl-1:12";
		sdc1_rclk_on = "/fragment@15/__overlay__:pinctrl-0:12";
		sdc2_clk_off = "/fragment@17/__overlay__:pinctrl-1:0";
		sdc2_clk_on = "/fragment@17/__overlay__:pinctrl-0:0";
		sdc2_cmd_off = "/fragment@17/__overlay__:pinctrl-1:4";
		sdc2_cmd_on = "/fragment@17/__overlay__:pinctrl-0:4";
		sdc2_data_off = "/fragment@17/__overlay__:pinctrl-1:8";
		sdc2_data_on = "/fragment@17/__overlay__:pinctrl-0:8";
		sdhc_1 = "/fragment@15:target:0";
		sdhc_2 = "/fragment@17:target:0";
		sdw_clk_active = "/fragment@11/__overlay__/sdw_clk_data_pinctrl:pinctrl-0:0";
		sdw_clk_sleep = "/fragment@11/__overlay__/sdw_clk_data_pinctrl:pinctrl-1:0";
		sdw_data_active = "/fragment@11/__overlay__/sdw_clk_data_pinctrl:pinctrl-0:4";
		sdw_data_sleep = "/fragment@11/__overlay__/sdw_clk_data_pinctrl:pinctrl-1:4";
		slim_aud = "/fragment@6:target:0", "/fragment@7:target:0", "/fragment@12:target:0", "/fragment@21:target:0";
		soc = "/fragment@4:target:0", "/fragment@8:target:0", "/fragment@11:target:0", "/fragment@18:target:0", "/fragment@24:target:0";
		spkr_1_sd_n_active = "/fragment@11/__overlay__/wsa_spkr_en1_pinctrl:pinctrl-0:0";
		spkr_1_sd_n_sleep = "/fragment@11/__overlay__/wsa_spkr_en1_pinctrl:pinctrl-1:0";
		spkr_2_sd_n_active = "/fragment@11/__overlay__/wsa_spkr_en2_pinctrl:pinctrl-0:0";
		spkr_2_sd_n_sleep = "/fragment@11/__overlay__/wsa_spkr_en2_pinctrl:pinctrl-1:0";
		stub_codec = "/fragment@9/__overlay__:asoc-codec:0", "/fragment@10/__overlay__:asoc-codec:0";
		tasha_mclk_default = "/fragment@11/__overlay__/audio_ext_clk:pinctrl-0:0", "/fragment@11/__overlay__/audio_ext_clk:pinctrl-1:0";
		tasha_snd = "/fragment@10:target:0";
		tasha_spkr_1_sd_n_active = "/fragment@6/__overlay__/tasha_codec/msm_cdc_pinctrll:pinctrl-0:0";
		tasha_spkr_1_sd_n_sleep = "/fragment@6/__overlay__/tasha_codec/msm_cdc_pinctrll:pinctrl-1:0";
		tasha_spkr_2_sd_n_active = "/fragment@6/__overlay__/tasha_codec/msm_cdc_pinctrlr:pinctrl-0:0";
		tasha_spkr_2_sd_n_sleep = "/fragment@6/__overlay__/tasha_codec/msm_cdc_pinctrlr:pinctrl-1:0";
		tavil_snd = "/fragment@9:target:0", "/fragment@23:target:0";
		ter_i2s_data0_active = "/fragment@11/__overlay__/tert_mi2s_pinctrl:pinctrl-0:0";
		ter_i2s_data0_sleep = "/fragment@11/__overlay__/tert_mi2s_pinctrl:pinctrl-1:0";
		ter_i2s_data1_active = "/fragment@11/__overlay__/tert_mi2s_pinctrl:pinctrl-0:4";
		ter_i2s_data1_sleep = "/fragment@11/__overlay__/tert_mi2s_pinctrl:pinctrl-1:4";
		ter_i2s_sck_active = "/fragment@11/__overlay__/tert_mi2s_pinctrl:pinctrl-0:8";
		ter_i2s_sck_sleep = "/fragment@11/__overlay__/tert_mi2s_pinctrl:pinctrl-1:8";
		titan_top_gdsc = "/fragment@5/__overlay__/qcom,cam-sensor@0:cam_clk-supply:0";
		tlmm = "/fragment@4/__overlay__/qcom,camera-ir-led@0:gpios:0", "/fragment@4/__overlay__/qcom,camera-ir-led@0:gpios:12", "/fragment@4/__overlay__/qcom,camera-ir-led@0:gpios:24", "/fragment@4/__overlay__/qcom,camera-ir-led@0:gpios:36", "/fragment@4/__overlay__/qcom,camera-ir-led@0:gpios:48", "/fragment@5/__overlay__/qcom,cam-sensor@0:gpios:0", "/fragment@5/__overlay__/qcom,cam-sensor@0:gpios:12", "/fragment@11/__overlay__/wcd9xxx-irq:interrupt-parent:0", "/fragment@11/__overlay__/wcd9xxx-irq:qcom,gpio-connect:0", "/fragment@16:target:0", "/fragment@17/__overlay__:cd-gpios:0", "/fragment@18/__overlay__/extcon_usb1:id-gpio:0", "/fragment@18/__overlay__/extcon_usb1:trig-gpio:0", "/fragment@23/__overlay__:qcom,linein-det-gpio:0", "/fragment@23/__overlay__:qcom,lineout-det-gpio:0", "/fragment@24/__overlay__/msm_cdc_pinctrl@11:qcom,cdc-rst-n-gpio:0";
		usb0 = "/fragment@3:target:0", "/fragment@19:target:0";
		wcd_intr_default = "/fragment@11/__overlay__/wcd9xxx-irq:pinctrl-0:0";
		wcd_usbc_analog_en1_active = "/fragment@11/__overlay__/msm_cdc_pinctrl_usbc_audio_en1:pinctrl-0:0";
		wcd_usbc_analog_en1_idle = "/fragment@11/__overlay__/msm_cdc_pinctrl_usbc_audio_en1:pinctrl-1:0";
	};

	__local_fixups__ {

		fragment@0 {

			__overlay__ {

				qcom,qpnp-smb2 {
					io-channels = <0x0 0x8 0x10 0x18>;
				};

				qpnp,fg {
					io-channels = <0x0 0x8>;
				};
			};
		};

		fragment@10 {

			__overlay__ {
				qcom,wsa-devs = <0x0 0x4 0x8 0xc>;
			};
		};

		fragment@11 {

			__overlay__ {

				audio_ext_clk_native {
					pinctrl-0 = <0x0>;
					pinctrl-1 = <0x0>;
					qcom,audio-ref-clk-gpio = <0x0>;
				};

				cdc_comp_pinctrl {
					pinctrl-0 = <0x0 0x4>;
					pinctrl-1 = <0x0 0x4>;
				};

				cdc_dmic_pinctrl {
					pinctrl-0 = <0x0 0x4>;
					pinctrl-1 = <0x0 0x4>;
				};

				cdc_pdm_pinctrl {
					pinctrl-0 = <0x0 0x4 0x8 0xc 0x10>;
					pinctrl-1 = <0x0 0x4 0x8 0xc 0x10>;
				};

				msm-sdw-codec@62ec1000 {
					qcom,cdc-sdw-gpios = <0x0>;

					swr_master {

						wsa881x_en@20170211 {
							qcom,spkr-sd-n-node = <0x0>;
						};

						wsa881x_en@20170212 {
							qcom,spkr-sd-n-node = <0x0>;
						};

						wsa881x_en@21170213 {
							qcom,spkr-sd-n-node = <0x0>;
						};

						wsa881x_en@21170214 {
							qcom,spkr-sd-n-node = <0x0>;
						};
					};
				};

				msm_cdc_pinctrl@64 {
					pinctrl-0 = <0x0>;
					pinctrl-1 = <0x0>;
				};

				qcom,wcd-dsp-mgr {
					qcom,wdsp-components = <0x0 0x8>;
				};
			};
		};

		fragment@12 {

			__overlay__ {

				tasha_codec {
					clocks = <0x0 0x8>;
					interrupt-parent = <0x0>;
					qcom,wcd-rst-gpio-node = <0x0>;
				};

				tavil_codec {
					clocks = <0x0>;
					interrupt-parent = <0x0>;
					qcom,wcd-rst-gpio-node = <0x0>;
				};
			};
		};

		fragment@17 {

			__overlay__ {
				pinctrl-0 = <0xc>;
				pinctrl-1 = <0xc>;
			};
		};

		fragment@18 {

			__overlay__ {

				extcon_usb1 {
					pinctrl-0 = <0x0 0x4>;
				};
			};
		};

		fragment@19 {

			__overlay__ {
				extcon = <0x0>;
			};
		};

		fragment@2 {

			__overlay__ {
				vbus-supply = <0x0>;
				vconn-supply = <0x0>;
			};
		};

		fragment@23 {

			__overlay__ {
				qcom,wsa-devs = <0x0 0x4>;
			};
		};

		fragment@3 {

			__overlay__ {
				extcon = <0xc 0x10>;
				vbus_dwc3-supply = <0x0>;
			};
		};

		fragment@5 {

			__overlay__ {

				qcom,cam-sensor@0 {
					ir-led-src = <0x0>;
				};
			};
		};

		fragment@6 {

			__overlay__ {

				tavil_codec {

					msm_cdc_pinctrl_hph_en0 {
						pinctrl-0 = <0x0>;
						pinctrl-1 = <0x0>;
					};

					msm_cdc_pinctrl_hph_en1 {
						pinctrl-0 = <0x0>;
						pinctrl-1 = <0x0>;
					};

					msm_cdc_pinctrl_us_euro_sw {
						pinctrl-0 = <0x0>;
						pinctrl-1 = <0x0>;
					};

					msm_cdc_pinctrll {
						pinctrl-0 = <0x0>;
						pinctrl-1 = <0x0>;
					};

					msm_cdc_pinctrlr {
						pinctrl-0 = <0x0>;
						pinctrl-1 = <0x0>;
					};
				};
			};
		};

		fragment@7 {

			__overlay__ {

				tasha_codec {

					swr_master {

						wsa881x@20170211 {
							qcom,spkr-sd-n-node = <0x0>;
						};

						wsa881x@20170212 {
							qcom,spkr-sd-n-node = <0x0>;
						};

						wsa881x@21170213 {
							qcom,spkr-sd-n-node = <0x0>;
						};

						wsa881x@21170214 {
							qcom,spkr-sd-n-node = <0x0>;
						};
					};
				};

				tavil_codec {

					swr_master {

						wsa881x@20170211 {
							qcom,spkr-sd-n-node = <0x0>;
						};

						wsa881x@20170212 {
							qcom,spkr-sd-n-node = <0x0>;
						};

						wsa881x@21170213 {
							qcom,spkr-sd-n-node = <0x0>;
						};

						wsa881x@21170214 {
							qcom,spkr-sd-n-node = <0x0>;
						};
					};
				};
			};
		};

		fragment@9 {

			__overlay__ {
				qcom,hph-en0-gpio = <0x0>;
				qcom,hph-en1-gpio = <0x0>;
				qcom,wsa-devs = <0x0 0x4 0x8 0xc>;
			};
		};
	};

	__symbols__ {
		cdc_comp_gpios = "/fragment@11/__overlay__/cdc_comp_pinctrl";
		cdc_dmic12_gpios_active = "/fragment@8/__overlay__/lpi_pinctrl@62b40000/dmic12_gpios_active";
		cdc_dmic12_gpios_sleep = "/fragment@8/__overlay__/lpi_pinctrl@62b40000/dmic12_gpios_sleep";
		cdc_dmic34_gpios_active = "/fragment@8/__overlay__/lpi_pinctrl@62b40000/dmic34_gpios_active";
		cdc_dmic34_gpios_sleep = "/fragment@8/__overlay__/lpi_pinctrl@62b40000/dmic34_gpios_sleep";
		cdc_dmic_gpios = "/fragment@11/__overlay__/cdc_dmic_pinctrl";
		cdc_pdm_2_gpios_active = "/fragment@8/__overlay__/lpi_pinctrl@62b40000/cdc_pdm_2_gpios_active";
		cdc_pdm_2_gpios_sleep = "/fragment@8/__overlay__/lpi_pinctrl@62b40000/cdc_pdm_2_gpios_sleep";
		cdc_pdm_clk_active = "/fragment@8/__overlay__/lpi_pinctrl@62b40000/cdc_pdm_clk_active";
		cdc_pdm_clk_sleep = "/fragment@8/__overlay__/lpi_pinctrl@62b40000/cdc_pdm_clk_sleep";
		cdc_pdm_gpios = "/fragment@11/__overlay__/cdc_pdm_pinctrl";
		cdc_pdm_rx0_active = "/fragment@8/__overlay__/lpi_pinctrl@62b40000/cdc_pdm_rx0_active";
		cdc_pdm_rx0_sleep = "/fragment@8/__overlay__/lpi_pinctrl@62b40000/cdc_pdm_rx0_sleep";
		cdc_pdm_rx1_2_active = "/fragment@8/__overlay__/lpi_pinctrl@62b40000/cdc_pdm_rx1_2_active";
		cdc_pdm_rx1_2_sleep = "/fragment@8/__overlay__/lpi_pinctrl@62b40000/cdc_pdm_rx1_2_sleep";
		cdc_pdm_sync_active = "/fragment@8/__overlay__/lpi_pinctrl@62b40000/cdc_pdm_sync_active";
		cdc_pdm_sync_sleep = "/fragment@8/__overlay__/lpi_pinctrl@62b40000/cdc_pdm_sync_sleep";
		cdc_rx0_comp_active = "/fragment@8/__overlay__/lpi_pinctrl@62b40000/cdc_pdm_rx0_comp_active";
		cdc_rx0_comp_sleep = "/fragment@8/__overlay__/lpi_pinctrl@62b40000/cdc_pdm_rx0_comp_sleep";
		cdc_rx1_comp_active = "/fragment@8/__overlay__/lpi_pinctrl@62b40000/cdc_pdm_rx1_comp_active";
		cdc_rx1_comp_sleep = "/fragment@8/__overlay__/lpi_pinctrl@62b40000/cdc_pdm_rx1_comp_sleep";
		cdc_sdw_gpios = "/fragment@11/__overlay__/sdw_clk_data_pinctrl";
		clock_audio = "/fragment@11/__overlay__/audio_ext_clk";
		clock_audio_lnbb = "/fragment@11/__overlay__/audio_ext_clk_lnbb";
		clock_audio_native = "/fragment@11/__overlay__/audio_ext_clk_native";
		extcon_usb1 = "/fragment@18/__overlay__/extcon_usb1";
		hph_en0_wcd_active = "/fragment@6/__overlay__/tavil_codec/wcd_pinctrl@5/hph_en0_wcd_active";
		hph_en0_wcd_sleep = "/fragment@6/__overlay__/tavil_codec/wcd_pinctrl@5/hph_en0_wcd_sleep";
		hph_en1_wcd_active = "/fragment@6/__overlay__/tavil_codec/wcd_pinctrl@5/hph_en1_wcd_active";
		hph_en1_wcd_sleep = "/fragment@6/__overlay__/tavil_codec/wcd_pinctrl@5/hph_en1_wcd_sleep";
		ir_led = "/fragment@4/__overlay__/qcom,camera-ir-led@0";
		lpi_cdc_reset_active = "/fragment@8/__overlay__/lpi_pinctrl@62b40000/lpi_cdc_reset_active";
		lpi_cdc_reset_sleep = "/fragment@8/__overlay__/lpi_pinctrl@62b40000/lpi_cdc_reset_sleep";
		lpi_mclk0_active = "/fragment@8/__overlay__/lpi_pinctrl@62b40000/lpi_mclk0_active";
		lpi_mclk0_sleep = "/fragment@8/__overlay__/lpi_pinctrl@62b40000/lpi_mclk0_sleep";
		lpi_tlmm = "/fragment@8/__overlay__/lpi_pinctrl@62b40000";
		msm_sdw_codec = "/fragment@11/__overlay__/msm-sdw-codec@62ec1000";
		pm660_charger = "/fragment@0/__overlay__/qcom,qpnp-smb2";
		pm660_fg = "/fragment@0/__overlay__/qpnp,fg";
		pm660_haptics = "/fragment@1/__overlay__/qcom,haptics@c000";
		pm660_rradc = "/fragment@0/__overlay__/rradc@4500";
		sdc2_cd_off = "/fragment@16/__overlay__/cd_off";
		sdc2_cd_on = "/fragment@16/__overlay__/cd_on";
		smb2_vbus = "/fragment@0/__overlay__/qcom,qpnp-smb2/qcom,smb2-vbus";
		smb2_vconn = "/fragment@0/__overlay__/qcom,qpnp-smb2/qcom,smb2-vconn";
		spkr_1_wcd_en_active = "/fragment@6/__overlay__/tavil_codec/wcd_pinctrl@5/spkr_1_wcd_en_active";
		spkr_1_wcd_en_sleep = "/fragment@6/__overlay__/tavil_codec/wcd_pinctrl@5/spkr_1_wcd_en_sleep";
		spkr_2_wcd_en_active = "/fragment@6/__overlay__/tavil_codec/wcd_pinctrl@5/spkr_2_sd_n_active";
		spkr_2_wcd_en_sleep = "/fragment@6/__overlay__/tavil_codec/wcd_pinctrl@5/spkr_2_sd_n_sleep";
		tavil_hph_en0 = "/fragment@6/__overlay__/tavil_codec/msm_cdc_pinctrl_hph_en0";
		tavil_hph_en1 = "/fragment@6/__overlay__/tavil_codec/msm_cdc_pinctrl_hph_en1";
		tavil_us_euro_sw = "/fragment@6/__overlay__/tavil_codec/msm_cdc_pinctrl_us_euro_sw";
		tert_mi2s_gpios = "/fragment@11/__overlay__/tert_mi2s_pinctrl";
		us_euro_sw_wcd_active = "/fragment@6/__overlay__/tavil_codec/wcd_pinctrl@5/us_euro_sw_wcd_active";
		us_euro_sw_wcd_sleep = "/fragment@6/__overlay__/tavil_codec/wcd_pinctrl@5/us_euro_sw_wcd_sleep";
		usb_det_default = "/fragment@16/__overlay__/usb_det_default";
		usb_id_det_default = "/fragment@16/__overlay__/usb_det_default/usb_id_det_default";
		usb_vbus_det_default = "/fragment@16/__overlay__/usb_det_default/usb_vbus_det_default";
		wcd = "/fragment@6/__overlay__/tavil_codec/wcd_pinctrl@5";
		wcd9335 = "/fragment@12/__overlay__/tasha_codec";
		wcd934x_cdc = "/fragment@12/__overlay__/tavil_codec";
		wcd9xxx_intc = "/fragment@11/__overlay__/wcd9xxx-irq";
		wcd_rst_gpio = "/fragment@11/__overlay__/msm_cdc_pinctrl@64";
		wcd_rst_gpio1 = "/fragment@24/__overlay__/msm_cdc_pinctrl@11";
		wcd_spi_0 = "/fragment@12/__overlay__/tavil_codec/wcd_spi";
		wcd_usbc_analog_en1_gpio = "/fragment@11/__overlay__/msm_cdc_pinctrl_usbc_audio_en1";
		wdsp_glink = "/fragment@11/__overlay__/qcom,wcd-dsp-glink";
		wdsp_mgr = "/fragment@11/__overlay__/qcom,wcd-dsp-mgr";
		wsa881x_0211 = "/fragment@7/__overlay__/tavil_codec/swr_master/wsa881x@20170211";
		wsa881x_0212 = "/fragment@7/__overlay__/tavil_codec/swr_master/wsa881x@20170212";
		wsa881x_0213 = "/fragment@7/__overlay__/tavil_codec/swr_master/wsa881x@21170213";
		wsa881x_0214 = "/fragment@7/__overlay__/tavil_codec/swr_master/wsa881x@21170214";
		wsa881x_211 = "/fragment@7/__overlay__/tasha_codec/swr_master/wsa881x@20170211";
		wsa881x_211_en = "/fragment@11/__overlay__/msm-sdw-codec@62ec1000/swr_master/wsa881x_en@20170211";
		wsa881x_212 = "/fragment@7/__overlay__/tasha_codec/swr_master/wsa881x@20170212";
		wsa881x_212_en = "/fragment@11/__overlay__/msm-sdw-codec@62ec1000/swr_master/wsa881x_en@20170212";
		wsa881x_213 = "/fragment@7/__overlay__/tasha_codec/swr_master/wsa881x@21170213";
		wsa881x_213_en = "/fragment@11/__overlay__/msm-sdw-codec@62ec1000/swr_master/wsa881x_en@21170213";
		wsa881x_214 = "/fragment@7/__overlay__/tasha_codec/swr_master/wsa881x@21170214";
		wsa881x_214_en = "/fragment@11/__overlay__/msm-sdw-codec@62ec1000/swr_master/wsa881x_en@21170214";
		wsa_spkr_en1 = "/fragment@11/__overlay__/wsa_spkr_en1_pinctrl";
		wsa_spkr_en2 = "/fragment@11/__overlay__/wsa_spkr_en2_pinctrl";
		wsa_spkr_sd1 = "/fragment@6/__overlay__/tasha_codec/msm_cdc_pinctrll";
		wsa_spkr_sd2 = "/fragment@6/__overlay__/tasha_codec/msm_cdc_pinctrlr";
		wsa_spkr_wcd_sd1 = "/fragment@6/__overlay__/tavil_codec/msm_cdc_pinctrll";
		wsa_spkr_wcd_sd2 = "/fragment@6/__overlay__/tavil_codec/msm_cdc_pinctrlr";
	};

	fragment@0 {
		target = <0xffffffff>;

		__overlay__ {

			qcom,qpnp-smb2 {
				#address-cells = <0x1>;
				#cooling-cells = <0x2>;
				#size-cells = <0x1>;
				compatible = "qcom,qpnp-smb2";
				dpdm-supply = <0xffffffff>;
				io-channel-names = "charger_temp", "charger_temp_max", "usbin_i", "usbin_v";
				io-channels = <0x1 0x8 0x1 0xa 0x1 0x3 0x1 0x4>;
				phandle = <0x4>;
				qcom,auto-recharge-soc;
				qcom,pmic-revid = <0xffffffff>;
				qcom,qcs605-ipc-wa;
				qcom,thermal-mitigation = <0x2dc6c0 0x2625a0 0x1e8480 0x16e360 0xf4240 0x7a120>;
				qcom,wipower-max-uw = <0x4c4b40>;

				qcom,bat-if@1200 {
					interrupt-names = "bat-temp", "bat-ocp", "bat-ov", "bat-low", "bat-therm-or-id-missing", "bat-terminal-missing";
					interrupts = <0x0 0x12 0x0 0x1 0x0 0x12 0x1 0x3 0x0 0x12 0x2 0x3 0x0 0x12 0x3 0x3 0x0 0x12 0x4 0x3 0x0 0x12 0x5 0x3>;
					reg = <0x1200 0x100>;
				};

				qcom,chgr-misc@1600 {
					interrupt-names = "wdog-snarl", "wdog-bark", "aicl-fail", "aicl-done", "high-duty-cycle", "input-current-limiting", "temperature-change", "switcher-power-ok";
					interrupts = <0x0 0x16 0x0 0x1 0x0 0x16 0x1 0x1 0x0 0x16 0x2 0x3 0x0 0x16 0x3 0x3 0x0 0x16 0x4 0x3 0x0 0x16 0x5 0x3 0x0 0x16 0x6 0x2 0x0 0x16 0x7 0x3>;
					reg = <0x1600 0x100>;
				};

				qcom,chgr@1000 {
					interrupt-names = "chg-error", "chg-state-change", "step-chg-state-change", "step-chg-soc-update-fail", "step-chg-soc-update-request";
					interrupts = <0x0 0x10 0x0 0x1 0x0 0x10 0x1 0x1 0x0 0x10 0x2 0x1 0x0 0x10 0x3 0x1 0x0 0x10 0x4 0x1>;
					reg = <0x1000 0x100>;
				};

				qcom,dc-chgpth@1400 {
					interrupt-names = "dcin-collapse", "dcin-lt-3p6v", "dcin-uv", "dcin-ov", "dcin-plugin", "div2-en-dg", "dcin-icl-change";
					interrupts = <0x0 0x14 0x0 0x3 0x0 0x14 0x1 0x3 0x0 0x14 0x2 0x3 0x0 0x14 0x3 0x3 0x0 0x14 0x4 0x3 0x0 0x14 0x5 0x3 0x0 0x14 0x6 0x1>;
					reg = <0x1400 0x100>;
				};

				qcom,otg@1100 {
					interrupt-names = "otg-fail", "otg-overcurrent", "otg-oc-dis-sw-sts", "testmode-change-detect";
					interrupts = <0x0 0x11 0x0 0x3 0x0 0x11 0x1 0x3 0x0 0x11 0x2 0x3 0x0 0x11 0x3 0x3>;
					reg = <0x1100 0x100>;
				};

				qcom,smb2-vbus {
					phandle = <0x2>;
					regulator-name = "smb2-vbus";
				};

				qcom,smb2-vconn {
					phandle = <0x3>;
					regulator-name = "smb2-vconn";
				};

				qcom,usb-chgpth@1300 {
					interrupt-names = "usbin-collapse", "usbin-lt-3p6v", "usbin-uv", "usbin-ov", "usbin-plugin", "usbin-src-change", "usbin-icl-change", "type-c-change";
					interrupts = <0x0 0x13 0x0 0x3 0x0 0x13 0x1 0x3 0x0 0x13 0x2 0x3 0x0 0x13 0x3 0x3 0x0 0x13 0x4 0x3 0x0 0x13 0x5 0x1 0x0 0x13 0x6 0x1 0x0 0x13 0x7 0x1>;
					reg = <0x1300 0x100>;
				};
			};

			qpnp,fg {
				#address-cells = <0x1>;
				#size-cells = <0x1>;
				compatible = "qcom,fg-gen3";
				io-channel-names = "rradc_batt_id", "rradc_die_temp";
				io-channels = <0x1 0x0 0x1 0x7>;
				phandle = <0x45>;
				qcom,cycle-counter-en;
				qcom,fg-auto-recharge-soc;
				qcom,fg-esr-timer-asleep = <0xe0 0x100>;
				qcom,fg-esr-timer-awake = <0x40 0x60>;
				qcom,fg-esr-timer-charging = <0x0 0x60>;
				qcom,fg-recharge-soc-thr = <0x62>;
				qcom,hold-soc-while-full;
				qcom,pmic-revid = <0xffffffff>;
				qcom,rradc-base = <0x4500>;
				status = "okay";

				qcom,fg-batt-info@4100 {
					interrupt-names = "vbatt-pred-delta", "vbatt-low", "esr-delta", "batt-missing", "batt-temp-delta";
					interrupts = <0x0 0x41 0x0 0x3 0x0 0x41 0x1 0x3 0x0 0x41 0x2 0x3 0x0 0x41 0x3 0x3 0x0 0x41 0x6 0x3>;
					reg = <0x4100 0x100>;
					status = "okay";
				};

				qcom,fg-batt-soc@4000 {
					interrupt-names = "soc-update", "soc-ready", "bsoc-delta", "msoc-delta", "msoc-low", "msoc-empty", "msoc-high", "msoc-full";
					interrupts = <0x0 0x40 0x0 0x3 0x0 0x40 0x1 0x3 0x0 0x40 0x2 0x1 0x0 0x40 0x3 0x1 0x0 0x40 0x4 0x3 0x0 0x40 0x5 0x1 0x0 0x40 0x6 0x3 0x0 0x40 0x7 0x3>;
					reg = <0x4000 0x100>;
					status = "okay";
				};

				qcom,fg-memif@4400 {
					interrupt-names = "ima-rdy", "mem-xcp", "dma-grant";
					interrupts = <0x0 0x44 0x0 0x3 0x0 0x44 0x1 0x3 0x0 0x44 0x2 0x3>;
					reg = <0x4400 0x100>;
					status = "okay";
				};
			};

			rradc@4500 {
				#address-cells = <0x1>;
				#io-channel-cells = <0x1>;
				#size-cells = <0x0>;
				compatible = "qcom,rradc";
				phandle = <0x1>;
				qcom,pmic-revid = <0xffffffff>;
				reg = <0x4500 0x100>;
			};
		};
	};

	fragment@1 {
		target = <0xffffffff>;

		__overlay__ {

			qcom,haptics@c000 {
				compatible = "qcom,qpnp-haptics";
				interrupt-names = "hap-sc-irq", "hap-play-irq";
				interrupts = <0x1 0xc0 0x0 0x3 0x1 0xc0 0x1 0x3>;
				phandle = <0x46>;
				qcom,actuator-type = <0x0>;
				qcom,en-brake;
				qcom,ilim-ma = <0x320>;
				qcom,lra-auto-res-mode = "qwd";
				qcom,lra-high-z = "opt0";
				qcom,lra-res-cal-period = <0x4>;
				qcom,misc-clk-trim-error-reg = <0xf3>;
				qcom,play-mode = "direct";
				qcom,pmic-misc = <0xffffffff>;
				qcom,pmic-revid = <0xffffffff>;
				qcom,sc-dbc-cycles = <0x8>;
				qcom,vmax-mv = <0xc80>;
				qcom,wave-play-rate-us = <0x1a0b>;
				reg = <0xc000 0x100>;
			};
		};
	};

	fragment@10 {
		target = <0xffffffff>;

		__overlay__ {
			asoc-codec = <0xffffffff>;
			asoc-codec-names = "msm-stub-codec.1";
			qcom,audio-routing = "AIF4 VI", "MCLK", "RX_BIAS", "MCLK", "MADINPUT", "MCLK", "hifi amp", "LINEOUT1", "hifi amp", "LINEOUT2", "AMIC2", "MIC BIAS2", "MIC BIAS2", "Headset Mic", "AMIC3", "MIC BIAS2", "MIC BIAS2", "ANCRight Headset Mic", "AMIC4", "MIC BIAS2", "MIC BIAS2", "ANCLeft Headset Mic", "AMIC5", "MIC BIAS3", "MIC BIAS3", "Handset Mic", "DMIC0", "MIC BIAS1", "MIC BIAS1", "Digital Mic0", "DMIC1", "MIC BIAS1", "MIC BIAS1", "Digital Mic1", "DMIC2", "MIC BIAS3", "MIC BIAS3", "Digital Mic2", "DMIC3", "MIC BIAS3", "MIC BIAS3", "Digital Mic3", "DMIC4", "MIC BIAS4", "MIC BIAS4", "Digital Mic4", "DMIC5", "MIC BIAS4", "MIC BIAS4", "Digital Mic5", "SpkrLeft IN", "SPK1 OUT", "SpkrRight IN", "SPK2 OUT";
			qcom,msm-mbhc-gnd-swh = <0x0>;
			qcom,msm-mbhc-hphl-swh = <0x0>;
			qcom,msm-mclk-freq = <0x927c00>;
			qcom,msm-mi2s-master = <0x1 0x1 0x1 0x1 0x1>;
			qcom,wsa-aux-dev-prefix = "SpkrLeft", "SpkrRight", "SpkrLeft", "SpkrRight";
			qcom,wsa-devs = <0x1a 0x1b 0x1c 0x1d>;
			qcom,wsa-max-devs = <0x2>;
		};
	};

	fragment@11 {
		target = <0xffffffff>;

		__overlay__ {

			audio_ext_clk {
				#clock-cells = <0x1>;
				clock-names = "osr_clk";
				clocks = <0xffffffff>;
				compatible = "qcom,audio-ref-clk";
				phandle = <0x3c>;
				pinctrl-0 = <0xffffffff>;
				pinctrl-1 = <0xffffffff>;
				pinctrl-names = "active", "sleep";
				qcom,audio-ref-clk-gpio = <0xffffffff 0x3 0x0>;
				qcom,node_has_rpm_clock;
				status = "disabled";
			};

			audio_ext_clk_lnbb {
				#clock-cells = <0x1>;
				clock-names = "osr_clk";
				clocks = <0xffffffff 0x2>;
				compatible = "qcom,audio-ref-clk";
				phandle = <0x3f>;
				qcom,node_has_rpm_clock;
				status = "okay";
			};

			audio_ext_clk_native {
				#clock-cells = <0x1>;
				compatible = "qcom,audio-ref-clk";
				phandle = <0x3d>;
				pinctrl-0 = <0x34>;
				pinctrl-1 = <0x35>;
				pinctrl-names = "sleep", "active";
				qcom,audio-ref-clk-gpio = <0x33 0x13 0x0>;
				qcom,codec-mclk-clk-freq = <0xac4400>;
				qcom,lpass-mclk-id = <0x116>;
				status = "disabled";
			};

			cdc_comp_pinctrl {
				compatible = "qcom,msm-cdc-pinctrl";
				phandle = <0x4b>;
				pinctrl-0 = <0x28 0x29>;
				pinctrl-1 = <0x2a 0x2b>;
				pinctrl-names = "aud_active", "aud_sleep";
				qcom,lpi-gpios;
				status = "disabled";
			};

			cdc_dmic_pinctrl {
				compatible = "qcom,msm-cdc-pinctrl";
				phandle = <0x4c>;
				pinctrl-0 = <0x2c 0x2d>;
				pinctrl-1 = <0x2e 0x2f>;
				pinctrl-names = "aud_active", "aud_sleep";
				qcom,lpi-gpios;
				status = "disabled";
			};

			cdc_pdm_pinctrl {
				compatible = "qcom,msm-cdc-pinctrl";
				phandle = <0x4a>;
				pinctrl-0 = <0x1e 0x1f 0x20 0x21 0x22>;
				pinctrl-1 = <0x23 0x24 0x25 0x26 0x27>;
				pinctrl-names = "aud_active", "aud_sleep";
				qcom,lpi-gpios;
				status = "disabled";
			};

			msm-sdw-codec@62ec1000 {
				compatible = "qcom,msm-sdw-codec";
				interrupt-names = "swr_master_irq";
				interrupts = <0x0 0x58 0x0>;
				phandle = <0x4d>;
				qcom,cdc-sdw-gpios = <0x30>;
				reg = <0x62ec1000 0x0>;
				status = "disabled";

				swr_master {
					#address-cells = <0x2>;
					#size-cells = <0x0>;
					compatible = "qcom,swr-wcd";

					wsa881x_en@20170211 {
						compatible = "qcom,wsa881x";
						phandle = <0x4e>;
						qcom,spkr-sd-n-node = <0x31>;
						reg = <0x0 0x20170211>;
					};

					wsa881x_en@20170212 {
						compatible = "qcom,wsa881x";
						phandle = <0x4f>;
						qcom,spkr-sd-n-node = <0x32>;
						reg = <0x0 0x20170212>;
					};

					wsa881x_en@21170213 {
						compatible = "qcom,wsa881x";
						phandle = <0x50>;
						qcom,spkr-sd-n-node = <0x31>;
						reg = <0x0 0x21170213>;
					};

					wsa881x_en@21170214 {
						compatible = "qcom,wsa881x";
						phandle = <0x51>;
						qcom,spkr-sd-n-node = <0x32>;
						reg = <0x0 0x21170214>;
					};
				};
			};

			msm_cdc_pinctrl@64 {
				compatible = "qcom,msm-cdc-pinctrl";
				phandle = <0x3b>;
				pinctrl-0 = <0x36>;
				pinctrl-1 = <0x37>;
				pinctrl-names = "aud_active", "aud_sleep";
				qcom,lpi-gpios;
				status = "disabled";
			};

			msm_cdc_pinctrl_usbc_audio_en1 {
				compatible = "qcom,msm-cdc-pinctrl";
				phandle = <0x49>;
				pinctrl-0 = <0xffffffff>;
				pinctrl-1 = <0xffffffff>;
				pinctrl-names = "aud_active", "aud_sleep";
			};

			qcom,wcd-dsp-glink {
				compatible = "qcom,wcd-dsp-glink";
				phandle = <0x53>;
				status = "okay";
			};

			qcom,wcd-dsp-mgr {
				compatible = "qcom,wcd-dsp-mgr";
				phandle = <0x52>;
				qcom,img-filename = "cpe_9340";
				qcom,wdsp-components = <0x38 0x0 0x39 0x1 0xffffffff 0x2>;
				status = "okay";
			};

			sdw_clk_data_pinctrl {
				compatible = "qcom,msm-cdc-pinctrl";
				phandle = <0x30>;
				pinctrl-0 = <0xffffffff 0xffffffff>;
				pinctrl-1 = <0xffffffff 0xffffffff>;
				pinctrl-names = "aud_active", "aud_sleep";
				status = "disabled";
			};

			tert_mi2s_pinctrl {
				compatible = "qcom,msm-cdc-pinctrl";
				phandle = <0x54>;
				pinctrl-0 = <0xffffffff 0xffffffff 0xffffffff>;
				pinctrl-1 = <0xffffffff 0xffffffff 0xffffffff>;
				pinctrl-names = "aud_active", "aud_sleep";
				status = "disabled";
			};

			wcd9xxx-irq {
				#interrupt-cells = <0x1>;
				compatible = "qcom,wcd9xxx-irq";
				interrupt-controller;
				interrupt-parent = <0xffffffff>;
				phandle = <0x3a>;
				pinctrl-0 = <0xffffffff>;
				pinctrl-names = "default";
				qcom,gpio-connect = <0xffffffff 0x50 0x0>;
				status = "okay";
			};

			wsa_spkr_en1_pinctrl {
				compatible = "qcom,msm-cdc-pinctrl";
				phandle = <0x31>;
				pinctrl-0 = <0xffffffff>;
				pinctrl-1 = <0xffffffff>;
				pinctrl-names = "aud_active", "aud_sleep";
				status = "disabled";
			};

			wsa_spkr_en2_pinctrl {
				compatible = "qcom,msm-cdc-pinctrl";
				phandle = <0x32>;
				pinctrl-0 = <0xffffffff>;
				pinctrl-1 = <0xffffffff>;
				pinctrl-names = "aud_active", "aud_sleep";
				status = "disabled";
			};
		};
	};

	fragment@12 {
		target = <0xffffffff>;

		__overlay__ {

			tasha_codec {
				clock-names = "wcd_clk", "wcd_native_clk";
				clocks = <0x3c 0x0 0x3d 0x3>;
				compatible = "qcom,tasha-slim-pgd";
				elemental-addr = [00 01 a0 01 17 02];
				interrupt-parent = <0x3a>;
				interrupts = <0x0 0x1 0x2 0x3 0x4 0x5 0x6 0x7 0x8 0x9 0xa 0xb 0xc 0xd 0xe 0xf 0x10 0x11 0x12 0x13 0x14 0x15 0x16 0x17 0x18 0x19 0x1a 0x1b 0x1c 0x1d 0x1e>;
				phandle = <0x55>;
				qcom,cdc-dmic-sample-rate = <0x493e00>;
				qcom,cdc-mad-dmic-rate = <0x927c0>;
				qcom,cdc-mclk-clk-rate = <0x927c00>;
				qcom,cdc-micbias1-mv = <0x708>;
				qcom,cdc-micbias2-mv = <0x708>;
				qcom,cdc-micbias3-mv = <0x708>;
				qcom,cdc-micbias4-mv = <0x708>;
				qcom,cdc-slim-ifd = "tasha-slim-ifd";
				qcom,cdc-slim-ifd-elemental-addr = [00 00 a0 01 17 02];
				qcom,cdc-static-supplies = "cdc-vdd-mic-bias";
				qcom,cdc-vdd-mic-bias-current = <0x76c0>;
				qcom,cdc-vdd-mic-bias-voltage = <0x328980 0x328980>;
				qcom,wcd-rst-gpio-node = <0x3b>;
				status = "disabled";
			};

			tavil_codec {
				clock-names = "wcd_clk";
				clocks = <0x3f 0x0>;
				compatible = "qcom,tavil-slim-pgd";
				elemental-addr = [00 01 50 02 17 02];
				interrupt-parent = <0x3a>;
				interrupts = <0x0 0x1 0x2 0x3 0x4 0x5 0x6 0x7 0x8 0x9 0xa 0xb 0xc 0xd 0xe 0xf 0x10 0x11 0x12 0x13 0x14 0x15 0x16 0x17 0x18 0x19 0x1a 0x1b 0x1c 0x1d 0x1e 0x1f>;
				phandle = <0x38>;
				qcom,cdc-dmic-sample-rate = <0x493e00>;
				qcom,cdc-mad-dmic-rate = <0x927c0>;
				qcom,cdc-mclk-clk-rate = <0x927c00>;
				qcom,cdc-micbias1-mv = <0x708>;
				qcom,cdc-micbias2-mv = <0x708>;
				qcom,cdc-micbias3-mv = <0x708>;
				qcom,cdc-micbias4-mv = <0x708>;
				qcom,cdc-slim-ifd = "tavil-slim-ifd";
				qcom,cdc-slim-ifd-elemental-addr = [00 00 50 02 17 02];
				qcom,cdc-vdd-mic-bias-current = <0x76c0>;
				qcom,cdc-vdd-mic-bias-voltage = <0x328980 0x328980>;
				qcom,wcd-rst-gpio-node = <0x3e>;
				qcom,wdsp-cmpnt-dev-name = "tavil_codec";
				status = "okay";

				wcd_spi {
					compatible = "qcom,wcd-spi-v2";
					phandle = <0x39>;
					qcom,chip-select = <0x0>;
					qcom,master-bus-num = <0x0>;
					qcom,max-frequency = <0x16e3600>;
					qcom,mem-base-addr = <0x100000>;
				};
			};
		};
	};

	fragment@13 {
		target = <0xffffffff>;

		__overlay__ {
			status = "disabled";
		};
	};

	fragment@14 {
		target = <0xffffffff>;

		__overlay__ {
			status = "ok";
		};
	};

	fragment@15 {
		target = <0xffffffff>;

		__overlay__ {
			pinctrl-0 = <0xffffffff 0xffffffff 0xffffffff 0xffffffff>;
			pinctrl-1 = <0xffffffff 0xffffffff 0xffffffff 0xffffffff>;
			pinctrl-names = "active", "sleep";
			qcom,vdd-current-level = <0x0 0x8b290>;
			qcom,vdd-io-always-on;
			qcom,vdd-io-current-level = <0x0 0x4f588>;
			qcom,vdd-io-lpm-sup;
			qcom,vdd-io-voltage-level = <0x1b7740 0x1b7740>;
			qcom,vdd-voltage-level = <0x2d2a80 0x2d2a80>;
			status = "ok";
			vdd-io-supply = <0xffffffff>;
			vdd-supply = <0xffffffff>;
		};
	};

	fragment@16 {
		target = <0xffffffff>;

		__overlay__ {

			cd_off {
				phandle = <0x41>;

				config {
					bias-disable;
					drive-strength = <0x2>;
					pins = "gpio116";
				};

				mux {
					function = "gpio";
					pins = "gpio116";
				};
			};

			cd_on {
				phandle = <0x40>;

				config {
					bias-pull-up;
					drive-strength = <0x2>;
					pins = "gpio116";
				};

				mux {
					function = "gpio";
					pins = "gpio116";
				};
			};

			usb_det_default {
				phandle = <0x56>;

				usb_id_det_default {
					phandle = <0x43>;

					config {
						bias-pull-down;
						drive-strength = <0x2>;
						output-enable;
						pins = "gpio131";
					};

					mux {
						function = "gpio";
						pins = "gpio131";
					};
				};

				usb_vbus_det_default {
					phandle = <0x42>;

					config {
						bias-pull-up;
						drive-strength = <0x2>;
						input-enable;
						pins = "gpio26";
					};
				};
			};
		};
	};

	fragment@17 {
		target = <0xffffffff>;

		__overlay__ {
			cd-gpios = <0xffffffff 0x74 0x1>;
			pinctrl-0 = <0xffffffff 0xffffffff 0xffffffff 0x40>;
			pinctrl-1 = <0xffffffff 0xffffffff 0xffffffff 0x41>;
			pinctrl-names = "active", "sleep";
			qcom,vdd-io-current-level = <0x0 0x55f0>;
			qcom,vdd-io-voltage-level = <0x1b7740 0x2d2a80>;
			status = "ok";
			vdd-io-supply = <0xffffffff>;
		};
	};

	fragment@18 {
		target = <0xffffffff>;

		__overlay__ {

			extcon_usb1 {
				compatible = "linux,extcon-usb-gpio";
				gpio-names = "gpio131";
				id-gpio = <0xffffffff 0x1a 0x1>;
				phandle = <0x44>;
				pinctrl-0 = <0x42 0x43>;
				pinctrl-names = "default";
				trig-gpio = <0xffffffff 0x83 0x0>;
			};
		};
	};

	fragment@19 {
		target = <0xffffffff>;

		__overlay__ {
			extcon = <0x44>;
		};
	};

	fragment@2 {
		target = <0xffffffff>;

		__overlay__ {
			vbus-supply = <0x2>;
			vconn-supply = <0x3>;
			vdd-pdphy-supply = <0xffffffff>;
		};
	};

	fragment@20 {
		target = <0xffffffff>;

		__overlay__ {
			status = "okay";
		};
	};

	fragment@21 {
		target = <0xffffffff>;

		__overlay__ {
			status = "okay";
		};
	};

	fragment@22 {
		target = <0xffffffff>;

		__overlay__ {
			status = "okay";
		};
	};

	fragment@23 {
		target = <0xffffffff>;

		__overlay__ {
			compatible = "qcom,qcs605-asoc-snd-tavil";
			pinctrl-0 = <0xffffffff 0xffffffff>;
			pinctrl-names = "default";
			qcom,audio-routing = "AIF4 VI", "MCLK", "RX_BIAS", "MCLK", "MADINPUT", "MCLK", "AMIC1", "MIC BIAS1", "MIC BIAS1", "Handset Mic", "AMIC2", "MIC BIAS2", "MIC BIAS2", "Headset Mic", "DMIC0", "MIC BIAS1", "MIC BIAS1", "Digital Mic0", "DMIC1", "MIC BIAS1", "MIC BIAS1", "Digital Mic1", "DMIC2", "MIC BIAS1", "MIC BIAS1", "Digital Mic2", "DMIC3", "MIC BIAS1", "MIC BIAS1", "Digital Mic3", "SpkrLeft IN", "SPK1 OUT";
			qcom,linein-det-gpio = <0xffffffff 0x7c 0x0>;
			qcom,linein-det-swh = <0x1>;
			qcom,lineout-det-gpio = <0xffffffff 0x7d 0x0>;
			qcom,lineout-det-swh = <0x1>;
			qcom,model = "qcs605-ipc-tavil-snd-card";
			qcom,wsa-aux-dev-prefix = "SpkrLeft", "SpkrLeft";
			qcom,wsa-devs = <0x16 0x18>;
			qcom,wsa-max-devs = <0x1>;
			status = "okay";
		};
	};

	fragment@24 {
		target = <0xffffffff>;

		__overlay__ {

			msm_cdc_pinctrl@11 {
				compatible = "qcom,msm-cdc-pinctrl";
				phandle = <0x3e>;
				pinctrl-0 = <0xffffffff>;
				pinctrl-1 = <0xffffffff>;
				pinctrl-names = "aud_active", "aud_sleep";
				qcom,cdc-rst-n-gpio = <0xffffffff 0xb 0x0>;
			};
		};
	};

	fragment@25 {
		target = <0xffffffff>;

		__overlay__ {
			status = "disabled";
		};
	};

	fragment@3 {
		target = <0xffffffff>;

		__overlay__ {
			extcon = <0xffffffff 0xffffffff 0xffffffff 0x4 0x4>;
			vbus_dwc3-supply = <0x2>;
		};
	};

	fragment@4 {
		target = <0xffffffff>;

		__overlay__ {

			qcom,camera-ir-led@0 {
				cell-index = <0x0>;
				compatible = "qcom,camera-ir-led";
				enable-active-high;
				gpio-no-mux = <0x0>;
				gpio-req-tbl-flags = <0x0 0x0 0x0 0x0 0x0>;
				gpio-req-tbl-label = "CAM_IR_LED", "CAM_IR_LED_CUR0", "CAM_IR_LED_CUR1", "CAM_IR_CUT1", "CAM_IR_CUT2";
				gpio-req-tbl-num = <0x0 0x1 0x2 0x3 0x4>;
				gpios = <0xffffffff 0x16 0x0 0xffffffff 0x8d 0x0 0xffffffff 0x8e 0x0 0xffffffff 0x6b 0x0 0xffffffff 0x6e 0x0>;
				phandle = <0x5>;
				pinctrl-0 = <0xffffffff>;
				pinctrl-1 = <0xffffffff>;
				pinctrl-names = "cam_default", "cam_suspend";
				reg = <0x0>;
				status = "ok";
			};
		};
	};

	fragment@5 {
		target = <0xffffffff>;

		__overlay__ {

			qcom,cam-res-mgr {
				compatible = "qcom,cam-res-mgr";
				status = "ok";
			};

			qcom,cam-sensor@0 {
				cam_clk-supply = <0xffffffff>;
				cam_vana-supply = <0xffffffff>;
				cam_vdig-supply = <0xffffffff>;
				cam_vio-supply = <0xffffffff>;
				cci-master = <0x0>;
				cell-index = <0x0>;
				clock-cntl-level = "turbo";
				clock-names = "cam_clk";
				clock-rates = <0x16e3600>;
				clocks = <0xffffffff 0x42>;
				compatible = "qcom,cam-sensor";
				csiphy-sd-index = <0x0>;
				gpio-no-mux = <0x0>;
				gpio-req-tbl-flags = <0x1 0x0>;
				gpio-req-tbl-label = "CAMIF_MCLK0", "CAM_RESET0";
				gpio-req-tbl-num = <0x0 0x1>;
				gpio-reset = <0x1>;
				gpios = <0xffffffff 0xd 0x0 0xffffffff 0x1e 0x0>;
				ir-led-src = <0x5>;
				pinctrl-0 = <0xffffffff 0xffffffff>;
				pinctrl-1 = <0xffffffff 0xffffffff>;
				pinctrl-names = "cam_default", "cam_suspend";
				reg = <0x0>;
				regulator-names = "cam_vio", "cam_vana", "cam_vdig", "cam_clk";
				rgltr-cntrl-support;
				rgltr-load-current = <0x0 0x13880 0x19a28 0x0>;
				rgltr-max-voltage = <0x1b7740 0x2c4020 0x124f80 0x0>;
				rgltr-min-voltage = <0x1b7740 0x2c4020 0x124f80 0x0>;
				sensor-mode = <0x0>;
				sensor-position-pitch = <0x0>;
				sensor-position-roll = <0x10e>;
				sensor-position-yaw = <0xb4>;
				status = "ok";
			};
		};
	};

	fragment@6 {
		target = <0xffffffff>;

		__overlay__ {

			tasha_codec {

				msm_cdc_pinctrll {
					compatible = "qcom,msm-cdc-pinctrl";
					phandle = <0x12>;
					pinctrl-0 = <0xffffffff>;
					pinctrl-1 = <0xffffffff>;
					pinctrl-names = "aud_active", "aud_sleep";
				};

				msm_cdc_pinctrlr {
					compatible = "qcom,msm-cdc-pinctrl";
					phandle = <0x13>;
					pinctrl-0 = <0xffffffff>;
					pinctrl-1 = <0xffffffff>;
					pinctrl-names = "aud_active", "aud_sleep";
				};
			};

			tavil_codec {

				msm_cdc_pinctrl_hph_en0 {
					compatible = "qcom,msm-cdc-pinctrl";
					phandle = <0x14>;
					pinctrl-0 = <0xc>;
					pinctrl-1 = <0xd>;
					pinctrl-names = "aud_active", "aud_sleep";
				};

				msm_cdc_pinctrl_hph_en1 {
					compatible = "qcom,msm-cdc-pinctrl";
					phandle = <0x15>;
					pinctrl-0 = <0xe>;
					pinctrl-1 = <0xf>;
					pinctrl-names = "aud_active", "aud_sleep";
				};

				msm_cdc_pinctrl_us_euro_sw {
					compatible = "qcom,msm-cdc-pinctrl";
					phandle = <0x48>;
					pinctrl-0 = <0xa>;
					pinctrl-1 = <0xb>;
					pinctrl-names = "aud_active", "aud_sleep";
				};

				msm_cdc_pinctrll {
					compatible = "qcom,msm-cdc-pinctrl";
					phandle = <0x10>;
					pinctrl-0 = <0x6>;
					pinctrl-1 = <0x7>;
					pinctrl-names = "aud_active", "aud_sleep";
				};

				msm_cdc_pinctrlr {
					compatible = "qcom,msm-cdc-pinctrl";
					phandle = <0x11>;
					pinctrl-0 = <0x8>;
					pinctrl-1 = <0x9>;
					pinctrl-names = "aud_active", "aud_sleep";
				};

				wcd_pinctrl@5 {
					#gpio-cells = <0x2>;
					compatible = "qcom,wcd-pinctrl";
					gpio-controller;
					phandle = <0x47>;
					qcom,num-gpios = <0x5>;

					hph_en0_wcd_active {
						phandle = <0xc>;

						config {
							output-high;
							pins = "gpio4";
						};

						mux {
							pins = "gpio4";
						};
					};

					hph_en0_wcd_sleep {
						phandle = <0xd>;

						config {
							output-low;
							pins = "gpio4";
						};

						mux {
							pins = "gpio4";
						};
					};

					hph_en1_wcd_active {
						phandle = <0xe>;

						config {
							output-high;
							pins = "gpio5";
						};

						mux {
							pins = "gpio5";
						};
					};

					hph_en1_wcd_sleep {
						phandle = <0xf>;

						config {
							output-low;
							pins = "gpio5";
						};

						mux {
							pins = "gpio5";
						};
					};

					spkr_1_wcd_en_active {
						phandle = <0x6>;

						config {
							output-high;
							pins = "gpio2";
						};

						mux {
							pins = "gpio2";
						};
					};

					spkr_1_wcd_en_sleep {
						phandle = <0x7>;

						config {
							input-enable;
							pins = "gpio2";
						};

						mux {
							pins = "gpio2";
						};
					};

					spkr_2_sd_n_active {
						phandle = <0x8>;

						config {
							output-high;
							pins = "gpio3";
						};

						mux {
							pins = "gpio3";
						};
					};

					spkr_2_sd_n_sleep {
						phandle = <0x9>;

						config {
							input-enable;
							pins = "gpio3";
						};

						mux {
							pins = "gpio3";
						};
					};

					us_euro_sw_wcd_active {
						phandle = <0xa>;

						config {
							output-high;
							pins = "gpio1";
						};

						mux {
							pins = "gpio1";
						};
					};

					us_euro_sw_wcd_sleep {
						phandle = <0xb>;

						config {
							output-low;
							pins = "gpio1";
						};

						mux {
							pins = "gpio1";
						};
					};
				};
			};
		};
	};

	fragment@7 {
		target = <0xffffffff>;

		__overlay__ {

			tasha_codec {

				swr_master {
					#address-cells = <0x2>;
					#size-cells = <0x0>;
					compatible = "qcom,swr-wcd";

					wsa881x@20170211 {
						compatible = "qcom,wsa881x";
						phandle = <0x1a>;
						qcom,spkr-sd-n-node = <0x12>;
						reg = <0x0 0x20170211>;
					};

					wsa881x@20170212 {
						compatible = "qcom,wsa881x";
						phandle = <0x1b>;
						qcom,spkr-sd-n-node = <0x13>;
						reg = <0x0 0x20170212>;
					};

					wsa881x@21170213 {
						compatible = "qcom,wsa881x";
						phandle = <0x1c>;
						qcom,spkr-sd-n-node = <0x12>;
						reg = <0x0 0x21170213>;
					};

					wsa881x@21170214 {
						compatible = "qcom,wsa881x";
						phandle = <0x1d>;
						qcom,spkr-sd-n-node = <0x13>;
						reg = <0x0 0x21170214>;
					};
				};
			};

			tavil_codec {

				swr_master {
					#address-cells = <0x2>;
					#size-cells = <0x0>;
					compatible = "qcom,swr-wcd";

					wsa881x@20170211 {
						compatible = "qcom,wsa881x";
						phandle = <0x16>;
						qcom,spkr-sd-n-node = <0x10>;
						reg = <0x0 0x20170211>;
					};

					wsa881x@20170212 {
						compatible = "qcom,wsa881x";
						phandle = <0x17>;
						qcom,spkr-sd-n-node = <0x11>;
						reg = <0x0 0x20170212>;
					};

					wsa881x@21170213 {
						compatible = "qcom,wsa881x";
						phandle = <0x18>;
						qcom,spkr-sd-n-node = <0x10>;
						reg = <0x0 0x21170213>;
					};

					wsa881x@21170214 {
						compatible = "qcom,wsa881x";
						phandle = <0x19>;
						qcom,spkr-sd-n-node = <0x11>;
						reg = <0x0 0x21170214>;
					};
				};
			};
		};
	};

	fragment@8 {
		target = <0xffffffff>;

		__overlay__ {

			lpi_pinctrl@62b40000 {
				#gpio-cells = <0x2>;
				compatible = "qcom,lpi-pinctrl";
				gpio-controller;
				phandle = <0x33>;
				qcom,num-gpios = <0x20>;
				reg = <0x62b40000 0x0>;

				cdc_pdm_2_gpios_active {
					phandle = <0x22>;

					config {
						drive-strength = <0x8>;
						pins = "gpio20";
					};

					mux {
						function = "func2";
						pins = "gpio20";
					};
				};

				cdc_pdm_2_gpios_sleep {
					phandle = <0x27>;

					config {
						bias-disable;
						drive-strength = <0x2>;
						pins = "gpio20";
					};

					mux {
						function = "func2";
						pins = "gpio20";
					};
				};

				cdc_pdm_clk_active {
					phandle = <0x1e>;

					config {
						drive-strength = <0x4>;
						output-low;
						pins = "gpio18";
					};

					mux {
						function = "func2";
						pins = "gpio18";
					};
				};

				cdc_pdm_clk_sleep {
					phandle = <0x23>;

					config {
						bias-disable;
						drive-strength = <0x2>;
						output-low;
						pins = "gpio18";
					};

					mux {
						function = "func2";
						pins = "gpio18";
					};
				};

				cdc_pdm_rx0_active {
					phandle = <0x20>;

					config {
						drive-strength = <0x4>;
						output-low;
						pins = "gpio21";
					};

					mux {
						function = "func2";
						pins = "gpio21";
					};
				};

				cdc_pdm_rx0_comp_active {
					phandle = <0x28>;

					config {
						drive-strength = <0x4>;
						pins = "gpio22";
					};

					mux {
						function = "func2";
						pins = "gpio22";
					};
				};

				cdc_pdm_rx0_comp_sleep {
					phandle = <0x2a>;

					config {
						bias-disable;
						drive-strength = <0x2>;
						pins = "gpio22";
					};

					mux {
						function = "func2";
						pins = "gpio22";
					};
				};

				cdc_pdm_rx0_sleep {
					phandle = <0x25>;

					config {
						bias-disable;
						drive-strength = <0x2>;
						output-low;
						pins = "gpio21";
					};

					mux {
						function = "func2";
						pins = "gpio21";
					};
				};

				cdc_pdm_rx1_2_active {
					phandle = <0x21>;

					config {
						drive-strength = <0x4>;
						output-low;
						pins = "gpio23", "gpio25";
					};

					mux {
						function = "func1";
						pins = "gpio23", "gpio25";
					};
				};

				cdc_pdm_rx1_2_sleep {
					phandle = <0x26>;

					config {
						bias-disable;
						drive-strength = <0x2>;
						output-low;
						pins = "gpio23", "gpio25";
					};

					mux {
						function = "func1";
						pins = "gpio23", "gpio25";
					};
				};

				cdc_pdm_rx1_comp_active {
					phandle = <0x29>;

					config {
						drive-strength = <0x4>;
						pins = "gpio24";
					};

					mux {
						function = "func1";
						pins = "gpio24";
					};
				};

				cdc_pdm_rx1_comp_sleep {
					phandle = <0x2b>;

					config {
						bias-disable;
						drive-strength = <0x2>;
						pins = "gpio24";
					};

					mux {
						function = "func1";
						pins = "gpio24";
					};
				};

				cdc_pdm_sync_active {
					phandle = <0x1f>;

					config {
						drive-strength = <0x4>;
						output-low;
						pins = "gpio19";
					};

					mux {
						function = "func3";
						pins = "gpio19";
					};
				};

				cdc_pdm_sync_sleep {
					phandle = <0x24>;

					config {
						bias-disable;
						drive-strength = <0x2>;
						output-low;
						pins = "gpio19";
					};

					mux {
						function = "func3";
						pins = "gpio19";
					};
				};

				dmic12_gpios_active {
					phandle = <0x2c>;

					config {
						drive-strength = <0x8>;
						output-high;
						pins = "gpio26", "gpio28";
					};

					mux {
						function = "func1";
						pins = "gpio26", "gpio28";
					};
				};

				dmic12_gpios_sleep {
					phandle = <0x2e>;

					config {
						bias-disable;
						drive-strength = <0x2>;
						output-low;
						pins = "gpio26", "gpio28";
					};

					mux {
						function = "func1";
						pins = "gpio26", "gpio28";
					};
				};

				dmic34_gpios_active {
					phandle = <0x2d>;

					config {
						drive-strength = <0x8>;
						input-enable;
						pins = "gpio27", "gpio29";
					};

					mux {
						function = "func1";
						pins = "gpio27", "gpio29";
					};
				};

				dmic34_gpios_sleep {
					phandle = <0x2f>;

					config {
						drive-strength = <0x2>;
						input-enable;
						pins = "gpio27", "gpio29";
						pull-down;
					};

					mux {
						function = "func1";
						pins = "gpio27", "gpio29";
					};
				};

				lpi_cdc_reset_active {
					phandle = <0x36>;

					config {
						drive-strength = <0x10>;
						output-high;
						pins = "gpio29";
					};

					mux {
						function = "func2";
						pins = "gpio29";
					};
				};

				lpi_cdc_reset_sleep {
					phandle = <0x37>;

					config {
						bias-disable;
						drive-strength = <0x10>;
						output-low;
						pins = "gpio29";
					};

					mux {
						function = "func2";
						pins = "gpio29";
					};
				};

				lpi_mclk0_active {
					phandle = <0x35>;

					config {
						bias-disable;
						drive-strength = <0x8>;
						output-low;
						pins = "gpio19";
					};

					mux {
						function = "func1";
						pins = "gpio19";
					};
				};

				lpi_mclk0_sleep {
					phandle = <0x34>;

					config {
						bias-disable;
						bias-pull-down;
						drive-strength = <0x2>;
						pins = "gpio19";
					};

					mux {
						function = "func1";
						pins = "gpio19";
					};
				};
			};
		};
	};

	fragment@9 {
		target = <0xffffffff>;

		__overlay__ {
			asoc-codec = <0xffffffff 0xffffffff>;
			asoc-codec-names = "msm-stub-codec.1", "msm-ext-disp-audio-codec-rx";
			qcom,audio-routing = "AIF4 VI", "MCLK", "RX_BIAS", "MCLK", "MADINPUT", "MCLK", "hifi amp", "LINEOUT1", "hifi amp", "LINEOUT2", "AMIC2", "MIC BIAS2", "MIC BIAS2", "Headset Mic", "AMIC3", "MIC BIAS2", "MIC BIAS2", "ANCRight Headset Mic", "AMIC4", "MIC BIAS2", "MIC BIAS2", "ANCLeft Headset Mic", "AMIC5", "MIC BIAS3", "MIC BIAS3", "Handset Mic", "DMIC0", "MIC BIAS1", "MIC BIAS1", "Digital Mic0", "DMIC1", "MIC BIAS1", "MIC BIAS1", "Digital Mic1", "DMIC2", "MIC BIAS3", "MIC BIAS3", "Digital Mic2", "DMIC3", "MIC BIAS3", "MIC BIAS3", "Digital Mic3", "DMIC4", "MIC BIAS4", "MIC BIAS4", "Digital Mic4", "DMIC5", "MIC BIAS4", "MIC BIAS4", "Digital Mic5", "SpkrLeft IN", "SPK1 OUT", "SpkrRight IN", "SPK2 OUT";
			qcom,hph-en0-gpio = <0x14>;
			qcom,hph-en1-gpio = <0x15>;
			qcom,msm-mbhc-gnd-swh = <0x1>;
			qcom,msm-mbhc-hphl-swh = <0x1>;
			qcom,msm-mclk-freq = <0x927c00>;
			qcom,msm-mi2s-master = <0x1 0x1 0x1 0x1 0x1>;
			qcom,wsa-aux-dev-prefix = "SpkrLeft", "SpkrRight", "SpkrLeft", "SpkrRight";
			qcom,wsa-devs = <0x16 0x17 0x18 0x19>;
			qcom,wsa-max-devs = <0x2>;
		};
	};
};
